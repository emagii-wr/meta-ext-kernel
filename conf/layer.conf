## conf/layer.conf
```bitbake
BBPATH ?= ""
# We have a conf and classes directory, add to BBPATH
BBPATH := "${LAYERDIR}:${BBPATH}"

# We have a packages directory, add to BBFILES
BBFILES := "${BBFILES} ${LAYERDIR}/recipes-*/*/*.bb \
	${LAYERDIR}/recipes-*/*/*.bbappend \
	${LAYERDIR}/classes/*.bbclass"

BBFILE_COLLECTIONS += "ext-kernel"
BBFILE_PATTERN_ext-kernel := "^${LAYERDIR}/"
BBFILE_PRIORITY_ext-kernel := "66"

YOCTO_ROOT = "${LAYERDIR}/../.."
```
